/*
 * VERTICAL COMBOS
 *
 * Only work on FLAT keycap profiles (DSA, XDA, uniform SA, etc.) that allow
 * single-finger vertical slides. Sculpted profiles (Cherry, OEM) are unreliable.
 *
 * KEY POSITIONS:
 *   ╭─────────────────────╮ ╭─────────────────────╮
 *   │ LT4 LT3 LT2 LT1 LT0 │ │ RT0 RT1 RT2 RT3 RT4 │
 *   │ LM4 LM3 LM2 LM1 LM0 │ │ RM0 RM1 RM2 RM3 RM4 │
 *   │ LB4 LB3 LB2 LB1 LB0 │ │ RB0 RB1 RB2 RB3 RB4 │
 *   ╰───────╮ LH2 LH1 LH0 │ │ RH0 RH1 RH2 ╭───────╯
 *           ╰─────────────╯ ╰─────────────╯
 *
 * SYMBOLS PROVIDED (8 total):
 *
 *   Left hand (top+home):   @                  Right hand (top+home):       +       &
 *   Left hand (home+bot):   `   \       ~      Right hand (home+bot):   _   -   /   |
 *
 * VISUAL LAYOUT (Colemak-DH):
 *   ╭───────────────────────╮ ╭───────────────────────╮
 *   │     @                 │ │         +       &     │
 *   │     W   F   P   B     │ │     J   L   U   Y     │
 *   │     ┃   ┃   ┃   ┃     │ │     ┃   ┃   ┃   ┃     │
 *   │     R   S   T   G     │ │     M   N   E   I     │
 *   │     ┃   ┃   ┃   ┃     │ │     ┃   ┃   ┃   ┃     │
 *   │     X   C   D   V     │ │     K   H   ,   .     │
 *   │     `   \       ~     │ │     _   -   /   |     │
 *   ╰───────────────────────╯ ╰───────────────────────╯
 *
 * These symbols complement combos_horizontal.dtsi. If you can't use vertical
 * combos due to keycap profile, you'll need alternative access via layers,
 * leader sequences, or other methods.
 */

#include "combos_config.dtsi"

/* Left hand - top to home row */
ZMK_COMBO(at,    &kp AT,       LT3 LM3,     DEF NAV NUM, COMBO_TERM_SLOW, COMBO_IDLE_SLOW)

/* Left hand - home to bottom row */
ZMK_COMBO(grave, &kp GRAVE,    LM3 LB3,     DEF NAV NUM, COMBO_TERM_SLOW, COMBO_IDLE_SLOW)
ZMK_COMBO(bslh,  &kp BSLH,     LM2 LB2,     DEF NAV NUM, COMBO_TERM_SLOW, COMBO_IDLE_SLOW)
ZMK_COMBO(tilde, &kp TILDE,    LM0 LB0,     DEF NAV NUM, COMBO_TERM_SLOW, COMBO_IDLE_SLOW)

/* Right hand - top to home row */
ZMK_COMBO(plus,  &kp PLUS,     RT1 RM1,     DEF NAV NUM, COMBO_TERM_SLOW, COMBO_IDLE_SLOW)
ZMK_COMBO(amps,  &kp AMPS,     RT3 RM3,     DEF NAV NUM, COMBO_TERM_SLOW, COMBO_IDLE_SLOW)

/* Right hand - home to bottom row */
ZMK_COMBO(under, &kp UNDER,    RM0 RB0,     DEF NAV NUM, COMBO_TERM_SLOW, COMBO_IDLE_SLOW)
ZMK_COMBO(minus, &kp MINUS,    RM1 RB1,     DEF NAV NUM, COMBO_TERM_SLOW, COMBO_IDLE_SLOW)
ZMK_COMBO(fslh,  &kp FSLH,     RM2 RB2,     DEF NAV NUM, COMBO_TERM_SLOW, COMBO_IDLE_SLOW)
ZMK_COMBO(pipe,  &kp PIPE,     RM3 RB3,     DEF NAV NUM, COMBO_TERM_SLOW, COMBO_IDLE_SLOW)

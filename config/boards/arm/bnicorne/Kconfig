## config/boards/arm/bnicorne/Kconfig
```kconfig
#
# Copyright (c) 2022 The ZMK Contributors
# SPDX-License-Identifier: MIT
#

config BOARD_BNICORNE_LEFT
    bool

config BOARD_BNICORNE_RIGHT
    bool
```
